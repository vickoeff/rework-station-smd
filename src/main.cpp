/* Solder Uap DIY — Firmware v1 */

#include <Arduino.h>
#include <Wire.h>
#include <SPI.h>
#include <U8g2lib.h>
#include <max6675.h>
#include <EEPROM.h>

void readTemperature();
void debugPrintSerial();
void readHandleSwitch();
void computePID();
void applySSR();
void handleButtons();
void drawUI();
void drawMainScreen();
void drawErrorScreen();

// ====== Pin Definitions ======
#define PIN_BTN_UP 2
#define PIN_BTN_DOWN 3
#define PIN_BTN_SELECT 4
#define PIN_HANDLE_SW 5
#define PIN_SSR 9
#define PIN_MAX_CS 10
#define PIN_MAX_SCK 13
#define PIN_MAX_SO 12
#define PIN_BUZZER A3

U8G2_SSD1306_128X64_NONAME_1_HW_I2C u8g2(U8G2_R0, U8X8_PIN_NONE);
MAX6675 thermocouple(PIN_MAX_SCK, PIN_MAX_CS, PIN_MAX_SO);

// ====== Safety Limits ======
const float TEMP_MAX_SAFETY = 480.0;
const float TEMP_MIN_SET = 100.0;
const float TEMP_MAX_SET = 450.0;
const float TEMP_DEFAULT = 300.0;
const int EEPROM_ADDR_SETPOINT = 0;

// ====== PID Parameters ======
double Kp = 8.0, Ki = 0.3, Kd = 4.0;
double setpoint = TEMP_DEFAULT;
double input = 0, output = 0;
double integral = 0, lastError = 0;
unsigned long lastPidTime = 0;
const unsigned long pidInterval = 250; // ms

// ====== Setpoint Ramping ======
double effectiveSetpoint = 0;
bool effectiveSetpointInitialized = false;
const double SETPOINT_RAMP_RATE = 1.5;

// ====== SSR Time Proportioning ======
const unsigned long windowSize = 1000; // ms
unsigned long windowStartTime = 0;
const bool SSR_ACTIVE_LOW = true;

void setSSR(bool energize)
{
  bool level = SSR_ACTIVE_LOW ? !energize : energize;
  digitalWrite(PIN_SSR, level ? HIGH : LOW);
}

// ====== State Machine ======
enum State
{
  STATE_RUN,
  STATE_STANDBY,
  STATE_ERROR
};
State currentState = STATE_RUN;
State lastState = STATE_RUN;

bool handleInStand = true;
bool thermoFault = false;

unsigned long lastBtnTime = 0;
const unsigned long debounceDelay = 200;

// ================= Deteksi gagang =================
void readHandleSwitch()
{
  handleInStand = (digitalRead(PIN_HANDLE_SW) == LOW);
}

// ================= Buzzer =================
struct BuzzStep
{
  uint16_t freq;
  uint16_t duration;
};

const BuzzStep PATTERN_STARTUP[] = {{1000, 100}, {0, 40}, {1500, 100}, {0, 40}, {2200, 150}};
const BuzzStep PATTERN_BUTTON[] = {{2500, 30}};
const BuzzStep PATTERN_RUN[] = {{1800, 100}};
const BuzzStep PATTERN_OFF[] = {{900, 80}, {0, 60}, {600, 120}};
const BuzzStep PATTERN_ERROR[] = {{400, 150}, {0, 100}};

const BuzzStep *buzzerPattern = nullptr;
uint8_t buzzerPatternLen = 0;
uint8_t buzzerStep = 0;
unsigned long buzzerStepStart = 0;
bool buzzerPlaying = false;

unsigned long lastErrorBeepTime = 0;
const unsigned long errorBeepInterval = 1500; // ms

void playPattern(const BuzzStep *pattern, uint8_t len)
{
  buzzerPattern = pattern;
  buzzerPatternLen = len;
  buzzerStep = 0;
  buzzerStepStart = millis();
  buzzerPlaying = true;
  if (pattern[0].freq > 0)
    tone(PIN_BUZZER, pattern[0].freq);
  else
    noTone(PIN_BUZZER);
}

void updateBuzzer()
{
  if (!buzzerPlaying)
    return;
  unsigned long now = millis();
  if (now - buzzerStepStart >= buzzerPattern[buzzerStep].duration)
  {
    buzzerStep++;
    buzzerStepStart = now;
    if (buzzerStep >= buzzerPatternLen)
    {
      buzzerPlaying = false;
      noTone(PIN_BUZZER);
      return;
    }
    if (buzzerPattern[buzzerStep].freq > 0)
    {
      tone(PIN_BUZZER, buzzerPattern[buzzerStep].freq);
    }
    else
    {
      noTone(PIN_BUZZER);
    }
  }
}

// ================= Bitmap UI =================
static const unsigned char image_paint_1_bits[] U8X8_PROGMEM = {0xf0, 0xff, 0xff, 0x07, 0x00, 0x00, 0x00, 0x00, 0x00, 0x00, 0x00, 0x00, 0x00,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 0x00, 0x00};
static const unsigned char image_paint_1_copy_1_bits[] U8X8_PROGMEM = {0x0c, 0x00, 0x00, 0x00, 0x08, 0x00, 0x00, 0x00, 0x18, 0x00, 0x00, 0x00, 0x18,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 0xff, 0x07};
static const unsigned char image_paint_1_copy_2_bits[] U8X8_PROGMEM = {0xff, 0xff, 0x7f, 0x1e, 0x00, 0x00, 0xc0, 0x00, 0x00, 0x00, 0x80, 0x03, 0x00,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 0x00, 0x08};
static const unsigned char image_paint_1_copy_3_bits[] U8X8_PROGMEM = {0x01, 0x00, 0x00, 0x00, 0x00, 0x00, 0x00, 0x00, 0x00, 0x00, 0x00, 0x00, 0x01,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 0xff, 0xb3};
static const unsigned char image_paint_1_copy_4_bits[] U8X8_PROGMEM = {0xff, 0xff, 0x7f, 0x00, 0x00, 0x00, 0xc0, 0x00, 0x00, 0x00, 0x80, 0x03, 0x00,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 0x00, 0x02};
static const unsigned char image_paint_1_copy_5_bits[] U8X8_PROGMEM = {0xf0, 0xff, 0xff, 0x07, 0x18, 0x00, 0x00, 0x00, 0x0e, 0xfc, 0xff, 0x0c, 0x02,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 0x00, 0x00};
static const unsigned char image_paint_1_copy_6_bits[] U8X8_PROGMEM = {0x18, 0x00, 0x00, 0x00, 0x18, 0x00, 0x00, 0x00, 0x18, 0x00, 0x00, 0x00, 0x18,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 0xff, 0x07};
static const unsigned char image_paint_1_copy_7_bits[] U8X8_PROGMEM = {0x0f, 0x00, 0x00, 0x00, 0x00, 0x0f, 0x00, 0x00, 0x00, 0x00, 0x0f, 0x00, 0x00,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 0xff, 0x0f};
static const unsigned char image_paint_12_bits[] U8X8_PROGMEM = {0x3c, 0x00, 0x00, 0x00, 0x10, 0x38, 0x00, 0x00, 0x00, 0x10, 0x18, 0x00, 0x00,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 0x00, 0x10};
static const unsigned char image_paint_38_bits[] U8X8_PROGMEM = {0x18, 0x04, 0x03};
static const unsigned char image_paint_48_bits[] U8X8_PROGMEM = {0x01, 0x00, 0x00, 0x00, 0x00, 0x00, 0x00, 0x04};
static const unsigned char image_paint_49_bits[] U8X8_PROGMEM = {0x01};
static const unsigned char image_paint_51_bits[] U8X8_PROGMEM = {0x01, 0x01, 0x00, 0x00, 0x00, 0x01};

// ================= Setup =================
void setup()
{
  Serial.begin(9600);

  pinMode(PIN_BTN_UP, INPUT_PULLUP);
  pinMode(PIN_BTN_DOWN, INPUT_PULLUP);
  pinMode(PIN_BTN_SELECT, INPUT_PULLUP);
  pinMode(PIN_HANDLE_SW, INPUT_PULLUP);
  pinMode(PIN_SSR, OUTPUT);
  setSSR(false);
  pinMode(PIN_BUZZER, OUTPUT);
  digitalWrite(PIN_BUZZER, LOW);

  EEPROM.get(EEPROM_ADDR_SETPOINT, setpoint);
  if (isnan(setpoint) || setpoint < TEMP_MIN_SET || setpoint > TEMP_MAX_SET)
  {
    setpoint = TEMP_DEFAULT;
  }

  u8g2.begin();
  windowStartTime = millis();

  playPattern(PATTERN_STARTUP, sizeof(PATTERN_STARTUP) / sizeof(PATTERN_STARTUP[0]));
}

// ================= Main Loop =================
void loop()
{
  readHandleSwitch();
  readTemperature();
  handleButtons();
  updateBuzzer();
  debugPrintSerial();

  if (thermoFault || input >= TEMP_MAX_SAFETY)
  {
    currentState = STATE_ERROR;
  }
  else if (handleInStand)
  {
    currentState = STATE_STANDBY;
  }
  else
  {
    currentState = STATE_RUN;
  }

  if (currentState != lastState)
  {
    if (currentState == STATE_RUN)
    {
      playPattern(PATTERN_RUN, sizeof(PATTERN_RUN) / sizeof(PATTERN_RUN[0]));
      effectiveSetpointInitialized = false;
    }
    else if (currentState == STATE_STANDBY)
    {
      playPattern(PATTERN_OFF, sizeof(PATTERN_OFF) / sizeof(PATTERN_OFF[0]));
    }
    else if (currentState == STATE_ERROR)
    {
      playPattern(PATTERN_ERROR, sizeof(PATTERN_ERROR) / sizeof(PATTERN_ERROR[0]));
      lastErrorBeepTime = millis();
    }
    lastState = currentState;
  }

  if (currentState == STATE_ERROR && !buzzerPlaying && (millis() - lastErrorBeepTime >= errorBeepInterval))
  {
    playPattern(PATTERN_ERROR, sizeof(PATTERN_ERROR) / sizeof(PATTERN_ERROR[0]));
    lastErrorBeepTime = millis();
  }

  switch (currentState)
  {
  case STATE_RUN:
    computePID();
    applySSR();
    break;
  case STATE_STANDBY:
    output = 0;
    integral = 0;
    setSSR(false);
    break;
  case STATE_ERROR:
    output = 0;
    integral = 0;
    setSSR(false);
    break;
  }

  drawUI();
}

// ================= Sensor & Kontrol =================
unsigned long lastTempReadTime = 0;
const unsigned long tempReadInterval = 250; // ms

void readTemperature()
{
  unsigned long now = millis();
  if (now - lastTempReadTime < tempReadInterval)
    return;
  lastTempReadTime = now;

  double raw = thermocouple.readCelsius();
  if (isnan(raw))
  {
    thermoFault = true;
  }
  else
  {
    thermoFault = false;
    input = raw;
  }
}

void debugPrintSerial()
{
  static unsigned long lastPrint = 0;
  unsigned long now = millis();
  if (now - lastPrint < 500)
    return;
  lastPrint = now;

  Serial.print(F("Input(C): "));
  Serial.print(input);
  Serial.print(F("  TargetAsli: "));
  Serial.print(setpoint);
  Serial.print(F("  TargetRamp: "));
  Serial.print(effectiveSetpoint);
  Serial.print(F("  Output(%): "));
  Serial.print(output);
  Serial.print(F("  ThermoFault: "));
  Serial.println(thermoFault ? "YA" : "tidak");
}

const double MAX_OUTPUT_STEP = 5.0;
void computePID()
{
  unsigned long now = millis();
  if (now - lastPidTime < pidInterval)
    return;
  double dt = (now - lastPidTime) / 1000.0;
  lastPidTime = now;

  if (!effectiveSetpointInitialized)
  {
    effectiveSetpoint = input;
    effectiveSetpointInitialized = true;
  }

  double maxSetpointStep = SETPOINT_RAMP_RATE * dt;
  if (setpoint > effectiveSetpoint)
  {
    effectiveSetpoint = min(effectiveSetpoint + maxSetpointStep, setpoint);
  }
  else if (setpoint < effectiveSetpoint)
  {
    effectiveSetpoint = max(effectiveSetpoint - maxSetpointStep, setpoint);
  }

  double error = effectiveSetpoint - input;

  double tentativeIntegral = integral + error * dt;
  double tentativeOutput = Kp * error + Ki * tentativeIntegral + Kd * (error - lastError) / dt;

  double targetOutput;
  if (tentativeOutput > 100)
  {
    targetOutput = 100;
  }
  else if (tentativeOutput < 0)
  {
    targetOutput = 0;
  }
  else
  {
    integral = tentativeIntegral;
    targetOutput = tentativeOutput;
  }

  // Ramp limiter
  if (targetOutput > output)
  {
    output = min(output + MAX_OUTPUT_STEP, targetOutput);
  }
  else if (targetOutput < output)
  {
    output = max(output - MAX_OUTPUT_STEP, targetOutput);
  }

  lastError = error;
}

void applySSR()
{
  unsigned long now = millis();
  if (now - windowStartTime > windowSize)
  {
    windowStartTime += windowSize;
  }
  unsigned long onTime = (unsigned long)((output / 100.0) * windowSize);
  if ((now - windowStartTime) < onTime)
  {
    setSSR(true);
  }
  else
  {
    setSSR(false);
  }
}

void handleButtons()
{
  if (millis() - lastBtnTime < debounceDelay)
    return;

  if (digitalRead(PIN_BTN_UP) == LOW)
  {
    setpoint += 5;
    if (setpoint > TEMP_MAX_SET)
      setpoint = TEMP_MAX_SET;
    EEPROM.put(EEPROM_ADDR_SETPOINT, setpoint);
    playPattern(PATTERN_BUTTON, sizeof(PATTERN_BUTTON) / sizeof(PATTERN_BUTTON[0]));
    lastBtnTime = millis();
  }
  else if (digitalRead(PIN_BTN_DOWN) == LOW)
  {
    setpoint -= 5;
    if (setpoint < TEMP_MIN_SET)
      setpoint = TEMP_MIN_SET;
    EEPROM.put(EEPROM_ADDR_SETPOINT, setpoint);
    playPattern(PATTERN_BUTTON, sizeof(PATTERN_BUTTON) / sizeof(PATTERN_BUTTON[0]));
    lastBtnTime = millis();
  }
  else if (digitalRead(PIN_BTN_SELECT) == LOW)
  {
    playPattern(PATTERN_BUTTON, sizeof(PATTERN_BUTTON) / sizeof(PATTERN_BUTTON[0]));
    lastBtnTime = millis();
  }
}

// ================= Draw UI =================
void drawUI()
{
  static unsigned long lastDraw = 0;
  if (millis() - lastDraw < 150)
    return;
  lastDraw = millis();

  u8g2.firstPage();
  do
  {
    u8g2.setFontMode(1);
    u8g2.setBitmapMode(1);
    if (currentState == STATE_ERROR)
    {
      drawErrorScreen();
    }
    else
    {
      drawMainScreen();
    }
  } while (u8g2.nextPage());
}

void drawMainScreen()
{
  u8g2.drawXBMP(0, 0, 97, 31, image_paint_1_bits);
  u8g2.drawXBMP(0, 31, 27, 33, image_paint_1_copy_1_bits);
  u8g2.drawXBMP(68, 0, 29, 64, image_paint_1_copy_2_bits);
  u8g2.drawXBMP(1, 27, 96, 37, image_paint_1_copy_3_bits);
  u8g2.drawXBMP(102, 0, 26, 36, image_paint_1_copy_4_bits);
  u8g2.drawXBMP(95, 0, 31, 62, image_paint_1_copy_5_bits);
  u8g2.drawXBMP(95, 33, 31, 31, image_paint_1_copy_6_bits);
  u8g2.drawXBMP(89, 5, 39, 59, image_paint_1_copy_7_bits);
  u8g2.drawXBMP(91, 27, 37, 10, image_paint_12_bits);
  u8g2.drawXBMP(98, 2, 5, 3, image_paint_38_bits);
  u8g2.drawXBMP(25, 2, 3, 8, image_paint_48_bits);
  u8g2.drawXBMP(24, 1, 1, 1, image_paint_49_bits);
  u8g2.drawXBMP(69, 1, 1, 1, image_paint_49_bits);
  u8g2.drawXBMP(70, 4, 1, 6, image_paint_51_bits);
  u8g2.drawLine(26, 63, 68, 63);
  u8g2.drawLine(6, 39, 87, 39);
  u8g2.drawFilledEllipse(111, 18, 2, 2);
  u8g2.drawFilledEllipse(111, 46, 3, 3);
  u8g2.drawFilledEllipse(111, 31, 7, 7);
  u8g2.drawEllipse(74, 28, 1, 1);

  // --- Title ---
  u8g2.drawFrame(26, -1, 42, 12);
  u8g2.setFont(u8g2_font_profont11_tr);
  u8g2.drawStr(30, 8, "H-AIR");

  // --- Percentage ---
  u8g2.setFont(u8g2_font_5x7_tr);
  char bufOut[6];
  snprintf(bufOut, sizeof(bufOut), "%3d%%", (int)output);
  u8g2.drawStr(2, 9, bufOut);

  // --- Label ---
  u8g2.setFont(u8g2_font_profont11_tr);
  u8g2.drawStr(12, 20, "Temperature");

  // --- Temperature ---
  char bufTemp[8];
  dtostrf(input, 4, 1, bufTemp);
  u8g2.setFont(u8g2_font_profont17_tr);
  u8g2.drawStr(8, 37, bufTemp);
  u8g2.drawStr(77, 37, "C");

  // --- Bar level heater ---
  u8g2.drawFrame(5, 41, 86, 13);
  int filledSegments = map((int)output, 0, 100, 0, 13);
  int segX = 7;
  for (int i = 0; i < 13; i++)
  {
    if (i < filledSegments)
    {
      u8g2.drawBox(segX, 43, 4, 9);
    }
    else
    {
      u8g2.drawFrame(segX, 43, 4, 9);
    }
    segX += 6;
  }

  // --- Status ---
  u8g2.setFont(u8g2_font_5x7_tr);
  const char *stateLabel = (currentState == STATE_STANDBY) ? "STANDBY" : "RUN";
  char bufState[14];
  snprintf(bufState, sizeof(bufState), "STATE:%s", stateLabel);
  u8g2.drawStr(8, 62, bufState);

  // --- Temperatur Setpoint ---
  u8g2.drawBox(58, 55, 33, 10);
  u8g2.setDrawColor(2);
  char bufSet[8];
  snprintf(bufSet, sizeof(bufSet), "%dC", (int)setpoint);
  u8g2.drawStr(66, 62, bufSet);
  u8g2.setDrawColor(1);
}

void drawErrorScreen()
{
  u8g2.setFont(u8g2_font_profont17_tr);
  u8g2.drawStr(15, 30, "ERROR!");
  u8g2.setFont(u8g2_font_profont11_tr);
  if (thermoFault)
  {
    u8g2.drawStr(2, 50, "Sensor putus/rusak");
  }
  else
  {
    u8g2.drawStr(2, 50, "Overtemp! Cek sistem");
  }
}